## Aircraft-Noise/esp32/bridge/main/Kconfig.projbuild
```kconfig
menu "Bridge settings"

    config BRIDGE_HAS_MIC
        bool "Bridge has a microphone"
        default n
        help
            On: the bridge measures its own INMP441 and reports it as node 0, and can
            stream its raw audio to the Pi ("audio on"). Off: it only relays the
            remote nodes. Its mic was moved to a node in Oct 2026, so this is off.

endmenu
```

## Aircraft-Noise/esp32/components/mic/Kconfig
```kconfig
menu "INMP441 microphone"

    config MIC_PIN_SCK
        int "SCK (bit clock) GPIO"
        default 4 if IDF_TARGET_ESP32S3
        default 26

    config MIC_PIN_WS
        int "WS (word select) GPIO"
        default 5 if IDF_TARGET_ESP32S3
        default 25

    config MIC_PIN_SD
        int "SD (data) GPIO"
        default 6 if IDF_TARGET_ESP32S3
        default 33

    config MIC_HIGHPASS_HZ
        int "High-pass filter cut-off (Hz)"
        range 10 200
        default 50
        help
            Removes rumble below what the INMP441 can really measure (it's rated
            from 60 Hz): wind, traffic vibration, knocks. Applies to the levels and
            the raw audio stream alike. Aircraft noise is mostly 50-1000 Hz.

    config MIC_AUDIO_GAIN_DB
        int "Digital gain for the raw 16-bit audio stream (dB)"
        range 0 36
        default 18
        help
            Applied only to audio streamed to the Pi/laptop, not to the reported levels.
            18 dB puts quiet rooms well above the 16-bit noise floor and only clips
            above roughly 100 dB SPL.

endmenu
```

## Aircraft-Noise/esp32/components/radio/Kconfig
```kconfig
menu "ESP-NOW radio"

    config RADIO_CHANNEL
        int "Wi-Fi channel (must be the same on all three boards)"
        range 1 13
        default 1

    config RADIO_LONG_RANGE
        bool "Long-range mode (must be the same on all three boards)"
        default n
        help
            Espressif's long-range (LR) mode: lower data rate, much better range through
            walls. Turn this on for all three boards if the far rooms drop packets.

endmenu
```

## Aircraft-Noise/esp32/node/main/Kconfig.projbuild
```kconfig
menu "Node settings"

    config NODE_ID
        int "Node ID (1 = A, 2 = B)"
        range 1 7
        default 1
        help
            Set by flash.sh from sdkconfig.node_a / sdkconfig.node_b.

    config NODE_BRIDGE_MAC
        string "Bridge MAC address"
        default "FF:FF:FF:FF:FF:FF"
        help
            The bridge prints its MAC at boot ({"type":"bridge","mac":...}).
            Left as FF:FF:FF:FF:FF:FF the node broadcasts until the bridge first
            replies, then switches to it. Broadcasts get no ACKs or retries, so set
            the real MAC once you know it.

    config NODE_DEEP_SLEEP
        bool "Deep sleep between heartbeats (battery power)"
        default y
        help
            On: wake every few seconds, check in with the bridge, and only listen
            when the Pi asks. Off: listen and report every second, for USB power.

    config NODE_HEARTBEAT_S
        int "Seconds between heartbeats while sleeping"
        depends on NODE_DEEP_SLEEP
        range 1 3600
        default 5

    config NODE_REPLY_WAIT_MS
        int "How long to stay awake for the bridge's reply (ms)"
        range 20 2000
        default 100

    config NODE_BOOT_AWAKE_S
        int "Seconds to stay awake after power-on (for 'audio on' over USB)"
        range 0 600
        default 30

    config NODE_BATTERY_ADC
        bool "Measure battery voltage on an ADC pin"
        default n

    config NODE_BATTERY_ADC_CHANNEL
        int "ADC1 channel for the battery divider"
        depends on NODE_BATTERY_ADC
        range 0 9
        default 0
        help
            ADC1 channel 0 is GPIO1 on the ESP32-S3 and GPIO36 on the original ESP32.

    config NODE_BATTERY_DIVIDER
        int "Divider ratio (battery voltage / ADC pin voltage)"
        depends on NODE_BATTERY_ADC
        range 1 10
        default 2

endmenu
```
